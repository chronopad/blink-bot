const unsigned char epd_bitmap_face_default_blink1 [] PROGMEM = {
    0x00, 0x00, 0x00, 0x00, 0x00, 0x00, 0x00, 0x00, 0x00, 0x00, 0x00, 0x00, 0x00, 0x00, 0x00, 0x00, 
    0x00, 0x00, 0x00, 0x00, 0x00, 0x00, 0x00, 0x00, 0x00, 0x00, 0x00, 0x00, 0x00, 0x00, 0x00, 0x00, 
    0x00, 0x00, 0x00, 0x00, 0x00, 0x00, 0x00, 0x00, 0x00, 0x00, 0x00, 0x00, 0x00, 0x00, 0x00, 0x00, 
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    0x00, 0x00, 0x00, 0x00, 0x00, 0x00, 0x00, 0x00, 0x00, 0x00, 0x00, 0x00, 0x00, 0x00, 0x00, 0x00
};
// 'face-blink2', 128x64px
const unsigned char epd_bitmap_face_default_blink2 [] PROGMEM = {
    0x00, 0x00, 0x00, 0x00, 0x00, 0x00, 0x00, 0x00, 0x00, 0x00, 0x00, 0x00, 0x00, 0x00, 0x00, 0x00, 
    0x00, 0x00, 0x00, 0x00, 0x00, 0x00, 0x00, 0x00, 0x00, 0x00, 0x00, 0x00, 0x00, 0x00, 0x00, 0x00, 
    0x00, 0x00, 0x00, 0x00, 0x00, 0x00, 0x00, 0x00, 0x00, 0x00, 0x00, 0x00, 0x00, 0x00, 0x00, 0x00, 
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    0x00, 0x00, 0x00, 0x00, 0x00, 0x00, 0x00, 0x00, 0x00, 0x00, 0x00, 0x00, 0x00, 0x00, 0x00, 0x00
};
// 'face-idle', 128x64px
const unsigned char epd_bitmap_face_default_idle [] PROGMEM = {
    0x00, 0x00, 0x00, 0x00, 0x00, 0x00, 0x00, 0x00, 0x00, 0x00, 0x00, 0x00, 0x00, 0x00, 0x00, 0x00, 
    0x00, 0x00, 0x00, 0x00, 0x00, 0x00, 0x00, 0x00, 0x00, 0x00, 0x00, 0x00, 0x00, 0x00, 0x00, 0x00, 
    0x00, 0x00, 0x00, 0x00, 0x00, 0x00, 0x00, 0x00, 0x00, 0x00, 0x00, 0x00, 0x00, 0x00, 0x00, 0x00, 
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    0x00, 0x00, 0x00, 0x00, 0x00, 0x00, 0x00, 0x00, 0x00, 0x00, 0x00, 0x00, 0x00, 0x00, 0x00, 0x00
};
// 'face-celebrate1', 128x64px
const unsigned char epd_bitmap_face_default_celebrate1 [] PROGMEM = {
    0x00, 0x00, 0x00, 0x00, 0x00, 0x00, 0x00, 0x00, 0x00, 0x00, 0x00, 0x00, 0x00, 0x00, 0x00, 0x00, 
    0x00, 0x00, 0x00, 0x00, 0x00, 0x00, 0x00, 0x00, 0x00, 0x00, 0x00, 0x00, 0x00, 0x00, 0x00, 0x00, 
    0x00, 0x00, 0x00, 0x00, 0x00, 0x00, 0x00, 0x00, 0x00, 0x00, 0x00, 0x00, 0x00, 0x00, 0x00, 0x00, 
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    0x00, 0x00, 0x00, 0x00, 0x00, 0x00, 0x00, 0x00, 0x00, 0x00, 0x00, 0x00, 0x00, 0x00, 0x00, 0x00
};

// 'face-rbman-blink', 128x64px
const unsigned char epd_bitmap_face_rbman_blink [] PROGMEM = {
	0x00, 0x00, 0x00, 0x00, 0x00, 0x00, 0x00, 0x00, 0x00, 0x00, 0x00, 0x00, 0x00, 0x00, 0x00, 0x00, 
	0x00, 0x00, 0x00, 0x00, 0x00, 0x00, 0x00, 0x00, 0x00, 0x00, 0x00, 0x00, 0x00, 0x00, 0x00, 0x00, 
	0x00, 0x00, 0x00, 0x00, 0x00, 0x00, 0x00, 0x00, 0x00, 0x00, 0x00, 0x00, 0x00, 0x00, 0x00, 0x00, 
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	0x00, 0x00, 0x00, 0x00, 0x00, 0x00, 0x00, 0x00, 0x00, 0x00, 0x00, 0x00, 0x00, 0x00, 0x00, 0x00
};
// 'face-rbman-idle', 128x64px
const unsigned char epd_bitmap_face_rbman_idle [] PROGMEM = {
	0x00, 0x00, 0x00, 0x00, 0x00, 0x00, 0x00, 0x00, 0x00, 0x00, 0x00, 0x00, 0x00, 0x00, 0x00, 0x00, 
	0x00, 0x00, 0x00, 0x00, 0x00, 0x00, 0x00, 0x00, 0x00, 0x00, 0x00, 0x00, 0x00, 0x00, 0x00, 0x00, 
	0x00, 0x00, 0x00, 0x03, 0xff, 0xfc, 0x00, 0x00, 0x00, 0x00, 0x00, 0x00, 0x33, 0x00, 0x00, 0x00, 
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	0x00, 0x00, 0x00, 0x00, 0x00, 0x00, 0x00, 0x00, 0x00, 0x00, 0x00, 0x00, 0x00, 0x00, 0x00, 0x00
};
// 'face-rbman-wink', 128x64px
const unsigned char epd_bitmap_face_rbman_wink [] PROGMEM = {
	0x00, 0x00, 0x00, 0x00, 0x00, 0x00, 0x00, 0x00, 0x00, 0x00, 0x00, 0x00, 0x00, 0x00, 0x00, 0x00, 
	0x00, 0x00, 0x00, 0x00, 0x00, 0x00, 0x00, 0x00, 0x00, 0x00, 0x00, 0x00, 0x00, 0x00, 0x00, 0x00, 
	0x00, 0x00, 0x00, 0x03, 0xff, 0xfc, 0x00, 0x00, 0x00, 0x00, 0x00, 0x00, 0x00, 0x00, 0x00, 0x00, 
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	0x00, 0x00, 0x00, 0x00, 0x00, 0x00, 0x00, 0x00, 0x00, 0x00, 0x00, 0x00, 0x00, 0x00, 0x00, 0x00
};

const int epd_bitmap_allArray_LEN = 7;
const unsigned char* epd_bitmap_allArray[7] = {
    epd_bitmap_face_default_blink1,
    epd_bitmap_face_default_blink2,
    epd_bitmap_face_default_idle,
    epd_bitmap_face_default_celebrate1,
    epd_bitmap_face_rbman_blink,
	epd_bitmap_face_rbman_idle,
	epd_bitmap_face_rbman_wink
};

#include <Wire.h>
#include <Adafruit_GFX.h>
#include <Adafruit_SSD1306.h>

#define SCREEN_WIDTH 128
#define SCREEN_HEIGHT 64
#define OLED_RESET -1
Adafruit_SSD1306 display(SCREEN_WIDTH, SCREEN_HEIGHT, &Wire, OLED_RESET);

// Button setup
const int buttonPins[6] = {0, 1, 2, 3, 5, 6};
int buttonStates[6];
int lastButtonStates[6];

// Buzzer setup
#define BUZZER_PIN 21
#define NOTE_A4 440
#define NOTE_C5 523
#define NOTE_F5 698

unsigned long buzzerStartTime = 0;
bool buzzerActive = false;
int buzzerToneType = 0; 
int buzzerFinishedCount = 0;
unsigned long buzzerFinishedLastChange = 0;

// Menu and states
const char* menuItems[] = {"Timer", "Stopwatch", "Pomodoro", "Settings", "Info"};
const int menuLength = 5;
int selectedItem = 0;
int currentPage = 0;
const int itemsPerPage = 4;
int totalPages = (menuLength + itemsPerPage - 1) / itemsPerPage; // Calculate total pages

bool showHome = true;
bool showMenu = false;
bool showTimer = false;
bool showStopwatch = false;
bool showPomodoro = false;
bool showSettings = false;
bool showInfo = false;

unsigned long lastInteraction = 0;
const unsigned long idleTimeout = 10000;

// Submenu variables
bool showSubMenu = false;
int subMenuIndex = 0;
int subMenuLength = 2;
const char* subMenuItems[] = {"CONTINUE", "RESET"};

// Timer variables
unsigned long _timerBegin = 0;
bool timerRunning = false;
bool timerFinished = false;
int timerMinutes = 0;
int timerSeconds = 3;
unsigned long timerTotalSeconds = timerMinutes * 60 + timerSeconds;
bool buzzerPlayedTimerFinished = false;
unsigned long timerPausedSeconds = timerTotalSeconds;

// Timer edit pointer
enum TimerEditField { TIMER_EDIT_MINUTE, TIMER_EDIT_SECOND };
TimerEditField timerEditField = TIMER_EDIT_MINUTE;

unsigned long lastBlinkTime = 0;
bool blinkVisible = true;
const unsigned long blinkInterval = 500;

// Stopwatch variables
unsigned long _stopwatchBegin = 0;
bool stopwatchRunning = false;
unsigned long stopwatchPausedMillis = 0;

// Pomodoro variables
enum PomodoroPhase { POMODORO_WORK, POMODORO_BREAK };
PomodoroPhase pomodoroPhase = POMODORO_WORK;

int pomodoroWorkMinutes = 1;
int pomodoroWorkSecondsConfig = 0;
int pomodoroBreakMinutes = 1;
int pomodoroBreakSecondsConfig = 0;

unsigned long pomodoroWorkSeconds = pomodoroWorkMinutes * 60 + pomodoroWorkSecondsConfig;
unsigned long pomodoroBreakSeconds = pomodoroBreakMinutes * 60 + pomodoroBreakSecondsConfig;

unsigned long pomodoroStartMillis = 0;
unsigned long pomodoroRemainingSeconds = pomodoroWorkSeconds;
bool pomodoroRunning = false;
bool pomodoroFinished = false;
bool buzzerPlayedPomodoroFinished = false;

enum PomodoroEditField { POMODORO_EDIT_MINUTE, POMODORO_EDIT_SECOND };
PomodoroEditField pomodoroEditField = POMODORO_EDIT_MINUTE;

// Animation variables
class FacePackage {
public:
    const unsigned char* const* idleFrames;
    const unsigned char* const* blinkFrames;
    const unsigned char* const* celebrateFrames;
    int idleFrameCount;
    int blinkFrameCount;
    int celebrateFrameCount;
};

// Default face package
const unsigned char* defaultIdleFrames[] = {
    epd_bitmap_face_default_idle
};

const unsigned char* defaultBlinkFrames[] = {
    epd_bitmap_face_default_blink1,
    epd_bitmap_face_default_blink1,
    epd_bitmap_face_default_blink1,
    epd_bitmap_face_default_blink2
};

const unsigned char* defaultCelebrateFrames[] = {
    epd_bitmap_face_default_celebrate1
};

FacePackage defaultFace = {
    defaultIdleFrames,
    defaultBlinkFrames,
    defaultCelebrateFrames,
    1,  // idleFrameCount
    4,  // blinkFrameCount
    1   // celebrateFrameCount
};

// Rbman face package
const unsigned char* rbmanIdleFrames[] = {
    epd_bitmap_face_rbman_idle
};

const unsigned char* rbmanBlinkFrames[] = {
    epd_bitmap_face_rbman_wink,
    epd_bitmap_face_rbman_wink,
    epd_bitmap_face_rbman_wink
};

const unsigned char* rbmanCelebrateFrames[] = {
    epd_bitmap_face_rbman_blink
};

FacePackage rbmanFace = {
    rbmanIdleFrames,
    rbmanBlinkFrames,
    rbmanCelebrateFrames,
    1,  // idleFrameCount
    3,  // blinkFrameCount
    1   // celebrateFrameCount
};

// FacePackage* currentFace = &defaultFace;
FacePackage* currentFace = &rbmanFace;

unsigned long lastAnimUpdate = 0;
const unsigned long animDelay = 200;   
const unsigned long animBlinkInterval = 2000; 
int currentFrame = 0;
bool isBlinking = false;
unsigned long lastAnimBlinkTime = 0;

unsigned long celebrationStartTime = 0;
bool celebrationAnimationPlaying = false;
const unsigned long celebrationDuration = 3000;
int celebrationBlinkCount = 0;
unsigned long celebrationLastChange = 0;
bool celebrationShowingCelebrate = true;

// Settings variables
int selectedFaceIndex = 0; 
const int totalFaces = 2;
const char* faceNames[] = {"Default", "???"};
FacePackage* facePackages[] = {&defaultFace, &rbmanFace};

int settingsSelectedItem = 0;
const int settingsMenuLength = 3;
const char* settingsMenuItems[] = {"Style", "Sound", "Display"};

void setup() {
    Serial.begin(115200);
    if (!display.begin(SSD1306_SWITCHCAPVCC, 0x3C)) {
        Serial.println(F("SSD1306 allocation failed"));
        for (;;);
    }
    
    pinMode(BUZZER_PIN, OUTPUT);
    
    for (int i = 0; i < 6; i++) {
        pinMode(buttonPins[i], INPUT_PULLUP);
        lastButtonStates[i] = HIGH;
    }

    currentFace = facePackages[selectedFaceIndex];
    
    drawHome();
}

void loop() {
    bool anyPressed = false;
    
    for (int i = 0; i < 6; i++) {
        buttonStates[i] = digitalRead(buttonPins[i]);
        
        if (buttonStates[i] == LOW && lastButtonStates[i] == HIGH) {
            anyPressed = true;
            lastInteraction = millis();
            
            if (showHome) {
                showHome = false;
                showMenu = true;
                drawMenu();
            } else if (showMenu) {
                if (i == 0) {
                    selectedItem--;
                    if (selectedItem < 0) {
                        selectedItem = menuLength - 1;
                        currentPage = totalPages - 1;
                    } else if (selectedItem < currentPage * itemsPerPage) {
                        currentPage--;
                    }
                    drawMenu();
                } else if (i == 1) {
                    selectedItem++;
                    if (selectedItem >= menuLength) {
                        selectedItem = 0;
                        currentPage = 0;
                    } else if (selectedItem >= (currentPage + 1) * itemsPerPage) {
                        currentPage++;
                    }
                    drawMenu();
                } else if (i == 2) { 
                    currentPage--;
                    if (currentPage < 0) currentPage = totalPages - 1;
                    selectedItem = currentPage * itemsPerPage;
                    drawMenu();
                } else if (i == 3) { 
                    currentPage++;
                    if (currentPage >= totalPages) currentPage = 0;
                    selectedItem = currentPage * itemsPerPage;
                    drawMenu();
                } else if (i == 4) {
                    selectMenuItem(selectedItem);
                } else if (i == 5) {
                    showMenu = false;
                    showHome = true;
                    drawHome();
                }
            } else {
                // Item Mode: Timer
                if (showTimer) {
                    // Timer configuration logic (only when timer is not running or finished)
                    if (!timerRunning && !timerFinished && !showSubMenu) {
                        if (i == 2) { // Left
                            timerEditField = TIMER_EDIT_MINUTE;
                            drawTimer();
                        } else if (i == 3) { // Right
                            timerEditField = TIMER_EDIT_SECOND;
                            drawTimer();
                        } else if (i == 0) { // Increase
                            if (timerEditField == TIMER_EDIT_MINUTE) {
                                timerMinutes = (timerMinutes + 1) % 60;
                            } else if (timerEditField == TIMER_EDIT_SECOND) {
                                timerSeconds = (timerSeconds + 1) % 60;
                            }
                            timerTotalSeconds = timerMinutes * 60 + timerSeconds;
                            timerPausedSeconds = timerTotalSeconds;
                            drawTimer();
                        } else if (i == 1) { // Decrease
                            if (timerEditField == TIMER_EDIT_MINUTE) {
                                timerMinutes = (timerMinutes == 0) ? 59 : timerMinutes - 1;
                            } else if (timerEditField == TIMER_EDIT_SECOND) {
                                timerSeconds = (timerSeconds == 0) ? 59 : timerSeconds - 1;
                            }
                            timerTotalSeconds = timerMinutes * 60 + timerSeconds;
                            timerPausedSeconds = timerTotalSeconds;
                            drawTimer();
                        }
                    }
                    
                    if (showSubMenu) {
                        if (i == 2) {
                            subMenuIndex--;
                            if (subMenuIndex < 0) subMenuIndex = subMenuLength - 1;
                            drawTimer();
                        } else if (i == 3) {
                            subMenuIndex++;
                            if (subMenuIndex >= subMenuLength) subMenuIndex = 0;
                            drawTimer();
                        } else if (i == 4) {
                            if (subMenuIndex == 0) {
                                // Continue
                                timerRunning = true;
                                _timerBegin = millis() - (timerTotalSeconds - timerPausedSeconds) * 1000;
                                showSubMenu = false;
                                buzzerStartStop(true);
                            } else {
                                // Reset
                                timerRunning = false;
                                timerFinished = false;
                                buzzerPlayedTimerFinished = false;
                                timerPausedSeconds = timerTotalSeconds;  // Reset to full time
                                showSubMenu = false;
                                drawTimer();
                                buzzerStartStop(false);
                            }
                        } else if (i == 5) {
                            timerRunning = false;
                            timerFinished = false;
                            buzzerPlayedTimerFinished = false;
                            timerPausedSeconds = timerTotalSeconds;
                            _timerBegin = 0;
                            showSubMenu = false;
                            showTimer = false;
                            showMenu = true;
                            buzzerStartStop(false);
                            drawMenu();
                        }
                    } else {
                        if (i == 4) {
                            if (timerFinished) {
                                timerRunning = false;
                                timerFinished = false;
                                buzzerPlayedTimerFinished = false;
                                timerPausedSeconds = timerTotalSeconds;
                                _timerBegin = 0;
                                drawTimer();
                                buzzerStartStop(false);
                            } else {
                                if (timerRunning) {
                                    // Pause timer
                                    timerPausedSeconds = getRemainingTimer();
                                    timerRunning = false;
                                    showSubMenu = true;
                                    subMenuIndex = 0;
                                    buzzerStartStop(false);
                                    drawTimer();
                                } else {
                                    // Start or resume
                                    if (timerPausedSeconds == 0 || timerPausedSeconds == timerTotalSeconds) {
                                        _timerBegin = millis();
                                        timerPausedSeconds = timerTotalSeconds;
                                    } else {
                                        _timerBegin = millis() - (timerTotalSeconds - timerPausedSeconds) * 1000;
                                    }
                                    timerRunning = true;
                                    timerFinished = false;
                                    buzzerStartStop(true);
                                }
                            }
                        } else if (i == 5) {
                            timerRunning = false;
                            timerFinished = false;
                            buzzerPlayedTimerFinished = false;
                            timerPausedSeconds = timerTotalSeconds;
                            showTimer = false;
                            showMenu = true;
                            drawMenu();
                        }
                    }
                }
                
                // Item Mode: Stopwatch
                else if (showStopwatch) {
                    if (showSubMenu) {
                        if (i == 2) {
                            subMenuIndex--;
                            if (subMenuIndex < 0) subMenuIndex = subMenuLength - 1;
                            drawStopwatch();
                        } else if (i == 3) {
                            subMenuIndex++;
                            if (subMenuIndex >= subMenuLength) subMenuIndex = 0;
                            drawStopwatch();
                        } else if (i == 4) {
                            if (subMenuIndex == 0) {
                                stopwatchRunning = true;
                                _stopwatchBegin = millis() - stopwatchPausedMillis;
                                showSubMenu = false;
                                buzzerStartStop(true);
                            } else {
                                stopwatchRunning = false;
                                _stopwatchBegin = 0;
                                stopwatchPausedMillis = 0;
                                showSubMenu = false;
                                buzzerStartStop(false);
                                drawStopwatch();
                            }
                        } else if (i == 5) {
                            stopwatchRunning = false;
                            stopwatchPausedMillis = 0;
                            _stopwatchBegin = 0;
                            showSubMenu = false;
                            showStopwatch = false;
                            showMenu = true;
                            buzzerStartStop(false);
                            drawMenu();
                        }
                    } else {
                        if (i == 4) {
                            if (stopwatchRunning) {
                                stopwatchPausedMillis = getElapsedStopwatch();
                                stopwatchRunning = false;
                                showSubMenu = true;
                                subMenuIndex = 0;
                                buzzerStartStop(false);
                                drawStopwatch();
                            } else {
                                stopwatchRunning = true;
                                _stopwatchBegin = millis() - stopwatchPausedMillis;
                                buzzerStartStop(true);
                            }
                        } else if (i == 5) {
                            stopwatchRunning = false;
                            stopwatchPausedMillis = 0;
                            showStopwatch = false;
                            showMenu = true;
                            drawMenu();
                        }
                    }
                }
                
                // Item Mode: Pomodoro
                else if (showPomodoro) {
                    if (!pomodoroRunning && !pomodoroFinished && !showSubMenu) {
                        if (i == 2) { // Left
                            pomodoroEditField = POMODORO_EDIT_MINUTE;
                            drawPomodoro();
                        } else if (i == 3) { // Right
                            pomodoroEditField = POMODORO_EDIT_SECOND;
                            drawPomodoro();
                        } else if (i == 0) { // Increase
                            if (pomodoroPhase == POMODORO_WORK) {
                                if (pomodoroEditField == POMODORO_EDIT_MINUTE) {
                                    pomodoroWorkMinutes = (pomodoroWorkMinutes + 1) % 60;
                                } else if (pomodoroEditField == POMODORO_EDIT_SECOND) {
                                    pomodoroWorkSecondsConfig = (pomodoroWorkSecondsConfig + 1) % 60;
                                }
                                pomodoroWorkSeconds = pomodoroWorkMinutes * 60 + pomodoroWorkSecondsConfig;
                                pomodoroRemainingSeconds = pomodoroWorkSeconds;
                            } else {
                                if (pomodoroEditField == POMODORO_EDIT_MINUTE) {
                                    pomodoroBreakMinutes = (pomodoroBreakMinutes + 1) % 60;
                                } else if (pomodoroEditField == POMODORO_EDIT_SECOND) {
                                    pomodoroBreakSecondsConfig = (pomodoroBreakSecondsConfig + 1) % 60;
                                }
                                pomodoroBreakSeconds = pomodoroBreakMinutes * 60 + pomodoroBreakSecondsConfig;
                                pomodoroRemainingSeconds = pomodoroBreakSeconds;
                            }
                            drawPomodoro();
                        } else if (i == 1) { // Decrease
                            if (pomodoroPhase == POMODORO_WORK) {
                                if (pomodoroEditField == POMODORO_EDIT_MINUTE) {
                                    pomodoroWorkMinutes = (pomodoroWorkMinutes == 0) ? 59 : pomodoroWorkMinutes - 1;
                                } else if (pomodoroEditField == POMODORO_EDIT_SECOND) {
                                    pomodoroWorkSecondsConfig = (pomodoroWorkSecondsConfig == 0) ? 59 : pomodoroWorkSecondsConfig - 1;
                                }
                                pomodoroWorkSeconds = pomodoroWorkMinutes * 60 + pomodoroWorkSecondsConfig;
                                pomodoroRemainingSeconds = pomodoroWorkSeconds;
                            } else {
                                if (pomodoroEditField == POMODORO_EDIT_MINUTE) {
                                    pomodoroBreakMinutes = (pomodoroBreakMinutes == 0) ? 59 : pomodoroBreakMinutes - 1;
                                } else if (pomodoroEditField == POMODORO_EDIT_SECOND) {
                                    pomodoroBreakSecondsConfig = (pomodoroBreakSecondsConfig == 0) ? 59 : pomodoroBreakSecondsConfig - 1;
                                }
                                pomodoroBreakSeconds = pomodoroBreakMinutes * 60 + pomodoroBreakSecondsConfig;
                                pomodoroRemainingSeconds = pomodoroBreakSeconds;
                            }
                            drawPomodoro();
                        }
                    }
                          
                    if (showSubMenu) {
                        // Navigate submenu
                        if (i == 2) { // Left
                            subMenuIndex--;
                            if (subMenuIndex < 0) subMenuIndex = subMenuLength - 1;
                            drawPomodoro();
                        } else if (i == 3) { // Right
                            subMenuIndex++;
                            if (subMenuIndex >= subMenuLength) subMenuIndex = 0;
                            drawPomodoro();
                        } else if (i == 4) { // Select
                            if (subMenuIndex == 0) { // Continue
                                unsigned long total = (pomodoroPhase == POMODORO_WORK) ? pomodoroWorkSeconds : pomodoroBreakSeconds;
                                pomodoroStartMillis = millis() - ((total - pomodoroRemainingSeconds) * 1000);
                                pomodoroRunning = true;
                                showSubMenu = false;
                                buzzerStartStop(true);
                            } else { // Reset
                                pomodoroPhase = POMODORO_WORK;
                                pomodoroRemainingSeconds = pomodoroWorkSeconds;
                                pomodoroRunning = false;
                                pomodoroFinished = false;
                                showSubMenu = false;
                                drawPomodoro();
                            }
                        } else if (i == 5) { // Back
                            pomodoroRunning = false;
                            pomodoroFinished = false;
                            showSubMenu = false;
                            showPomodoro = false;
                            showMenu = true;
                            drawMenu();
                        }
                    } else {
                        if (i == 4) { // Start / Pause
                            if (pomodoroFinished) {
                                // Switch to next phase and reset for configuration
                                if (pomodoroPhase == POMODORO_WORK) {
                                    pomodoroPhase = POMODORO_BREAK;
                                    pomodoroRemainingSeconds = pomodoroBreakSeconds;
                                } else {
                                    pomodoroPhase = POMODORO_WORK;
                                    pomodoroRemainingSeconds = pomodoroWorkSeconds;
                                }
                                
                                // Reset celebration and finished states
                                pomodoroFinished = false;
                                celebrationAnimationPlaying = false;
                                
                                // Reset edit field and blink state for configuration
                                pomodoroEditField = POMODORO_EDIT_MINUTE;
                                blinkVisible = true;
                                lastBlinkTime = millis();
                                
                                drawPomodoro();
                            } else if (pomodoroRunning) {
                                pomodoroRemainingSeconds = getRemainingPomodoro();
                                pomodoroRunning = false;
                                showSubMenu = true;
                                subMenuIndex = 0;
                                buzzerStartStop(false);
                                drawPomodoro();
                            } else {
                                unsigned long total = (pomodoroPhase == POMODORO_WORK) ? pomodoroWorkSeconds : pomodoroBreakSeconds;
                                pomodoroStartMillis = millis() - ((total - pomodoroRemainingSeconds) * 1000);
                                pomodoroRunning = true;
                                pomodoroFinished = false;
                                buzzerStartStop(true);
                                drawPomodoro();
                            }
                        } else if (i == 5) { // Back
                            pomodoroRunning = false;
                            pomodoroFinished = false;
                            celebrationAnimationPlaying = false;
                            showPomodoro = false;
                            showMenu = true;
                            drawMenu();
                        }
                    }
                }

                // Item Mode: Settings
                else if (showSettings) {
                    if (i == 0) { 
                        settingsSelectedItem--;
                        if (settingsSelectedItem < 0) settingsSelectedItem = settingsMenuLength - 1;
                        drawSettings();
                    } else if (i == 1) {
                        settingsSelectedItem++;
                        if (settingsSelectedItem >= settingsMenuLength) settingsSelectedItem = 0;
                        drawSettings();
                    } else if (i == 2 || i == 3) { // LEFT/RIGHT - Modify selected setting
                        if (settingsSelectedItem == 0) {
                            if (i == 2) {
                                selectedFaceIndex--;
                                if (selectedFaceIndex < 0) selectedFaceIndex = totalFaces - 1;
                            } else { 
                                selectedFaceIndex++;
                                if (selectedFaceIndex >= totalFaces) selectedFaceIndex = 0;
                            }
                            currentFace = facePackages[selectedFaceIndex];
                            drawSettings();
                        }
                        // Add more setting modifications here for other configuration
                    } else if (i == 5) {
                        showSettings = false;
                        showMenu = true;
                        drawMenu();
                    }
                }
                
                // Item Mode: Info
                else if (showInfo) {
                    if (i == 5) {
                        showInfo = false;
                        showMenu = true;
                        drawMenu();
                    }
                }
            }
        }
        lastButtonStates[i] = buttonStates[i];
    }
    
    if ((showMenu) && (millis() - lastInteraction > idleTimeout)) {
        showMenu = false;
        showHome = true;
        selectedItem = 0;
        currentPage = 0;
        drawHome();
    }
    
    updateTimer();
    updateStopwatch();
    updatePomodoro();
    updateHomeAnimation();
    updateBuzzer();
    
    display.display();
    
    delay(10);
}

void selectMenuItem(int index) {
    showMenu = false;
    
    switch (index) {
        case 0:
            timerTotalSeconds = timerMinutes * 60 + timerSeconds;
            timerPausedSeconds = timerTotalSeconds;
            showTimer = true;
            drawTimer();
            break;
        case 1:
            showStopwatch = true;
            drawStopwatch();
            break;
        case 2:
            showPomodoro = true;
            pomodoroPhase = POMODORO_WORK;
            pomodoroRemainingSeconds = pomodoroWorkSeconds;
            drawPomodoro();
            break;
        case 3:
            showSettings = true;
            drawSettings();
            break;
        case 4:
            showInfo = true;
            drawInfo();
            break;
    }
}

// ----- BUZZER SECTION -----

void buzzerStartStop(bool isStart) {
    buzzerStartTime = millis();
    buzzerActive = true;
    buzzerToneType = isStart ? 1 : 2;
    
    if (isStart) {
        tone(BUZZER_PIN, NOTE_C5);
    } else {
        tone(BUZZER_PIN, NOTE_A4);
    }
}

void buzzerTimerFinished() {
    buzzerStartTime = millis();
    buzzerActive = true;
    buzzerToneType = 3;
    buzzerFinishedCount = 0;
    buzzerFinishedLastChange = millis();
    tone(BUZZER_PIN, NOTE_F5);
}

void updateBuzzer() {
    if (!buzzerActive) return;
    
    unsigned long now = millis();
    
    if (buzzerToneType == 1 || buzzerToneType == 2) {
        // Start/Stop buzzer - single 100ms beep
        if (now - buzzerStartTime >= 100) {
            noTone(BUZZER_PIN);
            buzzerActive = false;
            buzzerToneType = 0;
        }
    } else if (buzzerToneType == 3) {
        // Finished buzzer - exactly 3 beeps of 150ms on, 150ms off
        unsigned long elapsed = now - buzzerFinishedLastChange;
        
        if (buzzerFinishedCount < 5) { // 5 changes = 3 beeps (on-off-on-off-on)
            if (elapsed >= 150) {
                if (buzzerFinishedCount % 2 == 0) {
                    // Turn off after beep
                    noTone(BUZZER_PIN);
                } else {
                    // Turn on for next beep
                    tone(BUZZER_PIN, NOTE_F5);
                }
                buzzerFinishedCount++;
                buzzerFinishedLastChange = now;
            }
        } else {
            // After 5th change (3rd beep is done), wait 150ms then turn off completely
            if (elapsed >= 150) {
                noTone(BUZZER_PIN);
                buzzerActive = false;
                buzzerToneType = 0;
            }
        }
    }
}

// ----- MENU ITEMS SECTION -----

unsigned long getRemainingTimer() {
    if (!timerRunning) return timerPausedSeconds;
    unsigned long elapsed = (millis() - _timerBegin) / 1000;
    long remaining = timerTotalSeconds - elapsed;
    return (remaining > 0) ? remaining : 0;
}

unsigned long getElapsedStopwatch() {
    if (!stopwatchRunning) return stopwatchPausedMillis;
    return millis() - _stopwatchBegin;
}

unsigned long getRemainingPomodoro() {
    if (!pomodoroRunning) return pomodoroRemainingSeconds;
    unsigned long elapsed = (millis() - pomodoroStartMillis) / 1000;
    long remaining = ((pomodoroPhase == POMODORO_WORK) ? pomodoroWorkSeconds : pomodoroBreakSeconds) - elapsed;
    return (remaining > 0) ? remaining : 0;
}

void updateTimer() {
    if (showTimer && timerRunning) {
        unsigned long remaining = getRemainingTimer();
        drawTimer();
        
        if (remaining == 0) {
            timerRunning = false;
            timerFinished = true;
            // Start celebration animation immediately
            celebrationAnimationPlaying = true;
            celebrationStartTime = millis();
            celebrationBlinkCount = 0;
            celebrationLastChange = millis();
            celebrationShowingCelebrate = true;
            // Play buzzer immediately
            buzzerTimerFinished();
            buzzerPlayedTimerFinished = true;
        }
    }
    
    if (showTimer && !timerRunning && !timerFinished && !showSubMenu) {
        if (millis() - lastBlinkTime > blinkInterval) {
            blinkVisible = !blinkVisible;
            lastBlinkTime = millis();
            drawTimer();
        }
    }
    
    // Update celebration animation if playing
    if (showTimer && timerFinished && celebrationAnimationPlaying) {
        drawTimer();
    }
    
    // Continue showing celebration face and "DONE" text even after animation ends
    if (showTimer && timerFinished && !celebrationAnimationPlaying) {
        drawTimer();
    }
}

void updateStopwatch() {
    if (showStopwatch && stopwatchRunning) drawStopwatch();
}

void updatePomodoro() {
    if (showPomodoro && pomodoroRunning) {
        unsigned long remaining = getRemainingPomodoro();
        drawPomodoro();
        
        if (remaining == 0 && !pomodoroFinished) {
            pomodoroRunning = false;
            pomodoroFinished = true; // Set to true to trigger celebration
            
            // Start celebration animation immediately
            celebrationAnimationPlaying = true;
            celebrationStartTime = millis();
            celebrationBlinkCount = 0;
            celebrationLastChange = millis();
            celebrationShowingCelebrate = true;
            
            buzzerTimerFinished();
            drawPomodoro();
        }
    } else if (showPomodoro && !pomodoroRunning && !pomodoroFinished && !showSubMenu) {
        if (millis() - lastBlinkTime > blinkInterval) {
            blinkVisible = !blinkVisible;
            lastBlinkTime = millis();
            drawPomodoro();
        }
    }
    
    // Update celebration animation if playing
    if (showPomodoro && pomodoroFinished && celebrationAnimationPlaying) {
        drawPomodoro();
    }
    
    // Continue showing celebration face and phase text even after animation ends
    if (showPomodoro && pomodoroFinished && !celebrationAnimationPlaying) {
        drawPomodoro();
    }
}

void updateHomeAnimation() {
    if (showHome) {
        updateFaceAnimation(true);
        display.display();
    }
}

void resetFaceAnimation() {
    isBlinking = false;
    currentFrame = 0;
    lastAnimBlinkTime = millis();
    lastAnimUpdate = millis();
}

void drawFaceFrame(const unsigned char* bmp) {
    display.fillRect(0, 0, SCREEN_WIDTH, SCREEN_HEIGHT, BLACK);
    display.drawBitmap(0, 0, bmp, SCREEN_WIDTH, SCREEN_HEIGHT, WHITE);
}

void updateFaceAnimation(bool active) {
    unsigned long now = millis();
    int blinkFramesLen = currentFace->blinkFrameCount; // Use currentFace instead of sizeof
    
    if (!active) {
        resetFaceAnimation();
        return;
    }
    
    if (!isBlinking && now - lastAnimBlinkTime >= animBlinkInterval) {
        isBlinking = true;
        currentFrame = 0;
        lastAnimBlinkTime = now;
        lastAnimUpdate = now - animDelay; 
    }
    
    if (isBlinking) {
        if (now - lastAnimUpdate >= animDelay) {
            lastAnimUpdate = now;
            if (currentFrame < blinkFramesLen) {
                drawFaceFrame(currentFace->blinkFrames[currentFrame]); // Use currentFace
                currentFrame++;
            }
            if (currentFrame >= blinkFramesLen) {
                isBlinking = false;
            }
        } else {
            int idx = currentFrame;
            if (idx >= blinkFramesLen) idx = blinkFramesLen - 1;
            if (idx < 0) idx = 0;
            drawFaceFrame(currentFace->blinkFrames[idx]); // Use currentFace
        }
        return;
    }
    
    drawFaceFrame(currentFace->idleFrames[0]); // Use currentFace
}

void updateCelebrationAnimation() {
    unsigned long now = millis();
    
    // Celebration blinks exactly 3 times: celebrate-idle-celebrate-idle-celebrate-idle
    if (celebrationBlinkCount < 5) { // 5 changes = 3 blinks (celebrate-idle-celebrate-idle-celebrate)
        unsigned long elapsed = now - celebrationLastChange;
        
        if (elapsed >= 250) { // 250ms for each state
            if (celebrationBlinkCount % 2 == 0) {
                // Switch to idle after celebrate
                celebrationShowingCelebrate = false;
            } else {
                // Switch to celebrate after idle
                celebrationShowingCelebrate = true;
            }
            celebrationBlinkCount++;
            celebrationLastChange = now;
        }
    } else {
        unsigned long elapsed = now - celebrationLastChange;
        if (elapsed >= 250) {
            celebrationAnimationPlaying = false;
        }
    }
    
    // Draw the appropriate frame using currentFace
    if (celebrationShowingCelebrate) {
        drawFaceFrame(currentFace->celebrateFrames[0]);
    } else {
        drawFaceFrame(currentFace->idleFrames[0]);
    }
}


// ----- DISPLAY SECTION -----

void drawSubMenu(int y = 50) {
    int buttonWidth = 60;
    int buttonHeight = 14;
    for (int i = 0; i < subMenuLength; i++) {
        int x = i * buttonWidth;
        if (i == subMenuIndex) {
            display.fillRect(x, y, buttonWidth, buttonHeight, SSD1306_WHITE);
            display.setTextColor(SSD1306_BLACK);
        } else {
            display.drawRect(x, y, buttonWidth, buttonHeight, SSD1306_WHITE);
            display.setTextColor(SSD1306_WHITE);
        }
        int16_t x1, y1; uint16_t w, h;
        display.getTextBounds(subMenuItems[i], 0, 0, &x1, &y1, &w, &h);
        int textX = x + (buttonWidth - w) / 2;
        int textY = y + (buttonHeight - h) / 2;
        display.setCursor(textX, textY);
        display.print(subMenuItems[i]);
    }
}

void drawHome() {
    display.fillRect(0, 50, SCREEN_WIDTH, 14, BLACK);
    display.setTextSize(2);
    display.setTextColor(SSD1306_WHITE);
    display.display();
}

void drawMenu() {
    display.clearDisplay();
    display.setTextSize(1);
    display.setTextColor(SSD1306_WHITE);
    display.setCursor(0, 0);
    display.print("MENU");
    
    // Show page indicator to the right of MENU title
    display.print(" (");
    display.print(currentPage + 1);
    display.print("/");
    display.print(totalPages);
    display.print(")");
    
    // Calculate which items to show on current page - strictly 4 items max
    int startIndex = currentPage * itemsPerPage;
    int endIndex = min(startIndex + itemsPerPage, menuLength);
    
    // Ensure we never show more than 4 items
    int itemsToShow = min(endIndex - startIndex, itemsPerPage);
    
    for (int i = 0; i < itemsToShow; i++) {
        int menuIndex = startIndex + i;
        if (menuIndex >= menuLength) break; // Safety check
        
        display.setCursor(5, 15 + (i * 12)); // i is display position (0-3)
        
        if (menuIndex == selectedItem) {
            display.print("> ");
            display.setTextColor(SSD1306_BLACK);
            display.fillRect(15, 15 + (i * 12) - 1, 110, 10, SSD1306_WHITE);
            display.setCursor(17, 15 + (i * 12));
        } else {
            display.print("  ");
        }
        
        display.print(menuItems[menuIndex]);
        display.setTextColor(SSD1306_WHITE);
    }
    
    display.display();
}

void drawTimer() {
    display.clearDisplay();
    
    unsigned long remaining = getRemainingTimer();
    if (!timerRunning && !timerFinished) remaining = timerPausedSeconds;
    
    int minutes = remaining / 60;
    int seconds = remaining % 60;
    
    if (timerRunning) {
        // Show face animation full screen
        updateFaceAnimation(true);
        
        // Draw timer overlay in bottom right corner
        display.setTextSize(1);
        display.setTextColor(SSD1306_WHITE);
        
        // Create timer string
        char timeStr[6];
        sprintf(timeStr, "%02d:%02d", minutes, seconds);
        
        // Calculate position for bottom right corner
        int16_t x1, y1;
        uint16_t w, h;
        display.getTextBounds(timeStr, 0, 0, &x1, &y1, &w, &h);
        int textX = SCREEN_WIDTH - w - 2;  // 2 pixels from right edge
        int textY = SCREEN_HEIGHT - h - 2; // 2 pixels from bottom
        
        // Draw background rectangle for better readability
        display.fillRect(textX - 1, textY - 1, w + 2, h + 2, SSD1306_BLACK);
        display.drawRect(textX - 1, textY - 1, w + 2, h + 2, SSD1306_WHITE);
        
        display.setCursor(textX + 1, textY);
        display.print(timeStr);
    } else if (timerFinished) {
        // Show celebrate animation full screen when timer is finished
        if (celebrationAnimationPlaying) {
            updateCelebrationAnimation();
        } else {
            drawFaceFrame(currentFace->celebrateFrames[0]);
        }
        
        // Draw "DONE" text overlay in bottom right corner
        display.setTextSize(1);
        display.setTextColor(SSD1306_WHITE);
        
        int16_t x1, y1;
        uint16_t w, h;
        display.getTextBounds("DONE", 0, 0, &x1, &y1, &w, &h);
        int textX = SCREEN_WIDTH - w - 2;  // 2 pixels from right edge
        int textY = SCREEN_HEIGHT - h - 2; // 2 pixels from bottom
        
        // Draw background rectangle for better readability
        display.fillRect(textX - 1, textY - 1, w + 2, h + 2, SSD1306_BLACK);
        display.drawRect(textX - 1, textY - 1, w + 2, h + 2, SSD1306_WHITE);
        
        display.setCursor(textX + 1, textY);
        display.print("DONE");
    } else {
        // Show regular timer interface when not running
        display.setTextSize(2);
        display.setTextColor(SSD1306_WHITE);
        
        display.setCursor(10, 20);
        display.printf("%02d:%02d", minutes, seconds);
        
        if (!timerFinished && !showSubMenu && blinkVisible) {
            if (timerEditField == TIMER_EDIT_MINUTE)
            display.fillRect(10, 45, 20, 2, SSD1306_WHITE);
            else if (timerEditField == TIMER_EDIT_SECOND)
            display.fillRect(46, 45, 20, 2, SSD1306_WHITE);
        }
        
        display.setTextSize(1);
        display.setCursor(0, 0);
        display.print("TIMER");
        
        if (showSubMenu) {
            drawSubMenu(50);
        }
    }

    display.display();
}

void drawStopwatch() {
    display.clearDisplay();
    display.setTextSize(2);
    display.setTextColor(SSD1306_WHITE);
    
    unsigned long elapsed;
    if (stopwatchRunning) elapsed = millis() - _stopwatchBegin;
    else elapsed = stopwatchPausedMillis;
    
    unsigned long minutes = (elapsed / 1000) / 60;
    unsigned long seconds = (elapsed / 1000) % 60;
    unsigned long millisecs = (elapsed % 1000) / 10;
    
    display.setCursor(10, 20);
    display.printf("%02lu:%02lu:%02lu", minutes, seconds, millisecs);
    
    display.setTextSize(1);
    display.setCursor(0, 0);
    display.print("STOPWATCH");
    
    if (showSubMenu) {
        drawSubMenu(50);
    }
    
    display.display();
}

void drawPomodoro() {
    display.clearDisplay();
    
    unsigned long remaining = getRemainingPomodoro();
    int minutes = remaining / 60;
    int seconds = remaining % 60;
    
    if (pomodoroRunning) {
        // Show face animation full screen
        updateFaceAnimation(true);
        
        // Draw timer overlay in bottom right corner
        display.setTextSize(1);
        display.setTextColor(SSD1306_WHITE);
        
        // Create timer string
        char timeStr[12];
        sprintf(timeStr, "%02d:%02d", minutes, seconds);
        
        // Calculate position for bottom right corner
        int16_t x1, y1;
        uint16_t w, h;
        display.getTextBounds(timeStr, 0, 0, &x1, &y1, &w, &h);
        int textX = SCREEN_WIDTH - w - 2;  // 2 pixels from right edge
        int textY = SCREEN_HEIGHT - h - 2; // 2 pixels from bottom
        
        // Draw background rectangle for better readability
        display.fillRect(textX - 1, textY - 1, w + 2, h + 2, SSD1306_BLACK);
        display.drawRect(textX - 1, textY - 1, w + 2, h + 2, SSD1306_WHITE);
        
        display.setCursor(textX + 1, textY);
        display.print(timeStr);
        
        // Draw phase state overlay in bottom left corner
        const char* phaseStateText = (pomodoroPhase == POMODORO_WORK) ? "WORK" : "BREAK";
        display.getTextBounds(phaseStateText, 0, 0, &x1, &y1, &w, &h);
        int stateX = 2;  // 2 pixels from left edge
        int stateY = SCREEN_HEIGHT - h - 2; // 2 pixels from bottom
        
        // Draw background rectangle for state
        display.fillRect(stateX - 1, stateY - 1, w + 2, h + 2, SSD1306_BLACK);
        display.drawRect(stateX - 1, stateY - 1, w + 2, h + 2, SSD1306_WHITE);
        
        display.setCursor(stateX + 1, stateY);
        display.print(phaseStateText);
    } else if (pomodoroFinished) {
        // Show celebrate animation full screen when pomodoro phase is finished
        if (celebrationAnimationPlaying) {
            updateCelebrationAnimation();
        } else {
            drawFaceFrame(currentFace->celebrateFrames[0]);
        }
        
        // Draw phase completion text overlay in bottom right corner
        display.setTextSize(1);
        display.setTextColor(SSD1306_WHITE);
        
        const char* phaseText = "DONE";
        
        int16_t x1, y1;
        uint16_t w, h;
        display.getTextBounds(phaseText, 0, 0, &x1, &y1, &w, &h);
        int textX = SCREEN_WIDTH - w - 2;  // 2 pixels from right edge
        int textY = SCREEN_HEIGHT - h - 2; // 2 pixels from bottom
        
        // Draw background rectangle for better readability
        display.fillRect(textX - 1, textY - 1, w + 2, h + 2, SSD1306_BLACK);
        display.drawRect(textX - 1, textY - 1, w + 2, h + 2, SSD1306_WHITE);
        
        display.setCursor(textX + 1, textY);
        display.print(phaseText);
        
        // Draw phase state overlay in bottom left corner
        const char* phaseStateText = (pomodoroPhase == POMODORO_WORK) ? "WORK" : "BREAK";
        display.getTextBounds(phaseStateText, 0, 0, &x1, &y1, &w, &h);
        int stateX = 2;  // 2 pixels from left edge
        int stateY = SCREEN_HEIGHT - h - 2; // 2 pixels from bottom
        
        // Draw background rectangle for state
        display.fillRect(stateX - 1, stateY - 1, w + 2, h + 2, SSD1306_BLACK);
        display.drawRect(stateX - 1, stateY - 1, w + 2, h + 2, SSD1306_WHITE);
        
        display.setCursor(stateX + 1, stateY);
        display.print(phaseStateText);
    } else {
        // Show regular pomodoro interface when not running
        display.setTextSize(2);
        display.setTextColor(SSD1306_WHITE);
        
        display.setCursor(10, 20);
        display.printf("%02d:%02d", minutes, seconds);
        
        // Show edit indicators under the main timer text (similar to timer)
        if (!pomodoroFinished && !showSubMenu && blinkVisible) {
            if (pomodoroEditField == POMODORO_EDIT_MINUTE)
                display.fillRect(10, 45, 20, 2, SSD1306_WHITE);
            else if (pomodoroEditField == POMODORO_EDIT_SECOND)
                display.fillRect(46, 45, 20, 2, SSD1306_WHITE);
        }
        
        display.setTextSize(1);
        display.setCursor(0, 0);
        if (pomodoroPhase == POMODORO_WORK)
            display.print("POMODORO - WORK");
        else
            display.print("POMODORO - BREAK");
        
        if (showSubMenu) {
            drawSubMenu(50);
        }
    }
    
    display.display();
}

void drawSettings() {
    display.clearDisplay();
    display.setTextSize(1);
    display.setTextColor(SSD1306_WHITE);
    
    // Title
    display.setCursor(0, 0);
    display.println("SETTINGS");
    
    // Settings menu items
    for (int i = 0; i < settingsMenuLength; i++) {
        display.setCursor(5, 15 + (i * 12));
        
        // Highlight selected item
        if (i == settingsSelectedItem) {
            display.print("> ");
            display.setTextColor(SSD1306_BLACK);
            display.fillRect(15, 15 + (i * 12) - 1, 110, 10, SSD1306_WHITE);
            display.setCursor(17, 15 + (i * 12));
        } else {
            display.print("  ");
        }
        
        // Show setting name and current value
        display.print(settingsMenuItems[i]);
        display.print(": ");
        
        // Show current value based on setting type
        if (i == 0) { // Face Style
            display.print(faceNames[selectedFaceIndex]);
        } else if (i == 1) { // Sound
            display.print("ON"); // Placeholder
        } else if (i == 2) { // Display
            display.print("BRIGHT"); // Placeholder
        }
        
        display.setTextColor(SSD1306_WHITE); // Reset color
    }
    
    display.display();
}

void drawInfo() {
    display.clearDisplay();
    display.setTextSize(1);
    display.setTextColor(SSD1306_WHITE);
    display.setCursor(0, 0);
    display.println("INFO");
    display.setCursor(10, 15);
    display.println("Blink Bot");
    display.setCursor(10, 25);
    display.println("Lorem ipsum..");
    display.display();
}
